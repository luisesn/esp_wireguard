## examples/demo/main/Kconfig.projbuild
```kconfig
menu "Example Configuration"

    config ESP_WIFI_SSID
        string "WiFi SSID"
        default "myssid"
        help
            SSID (network name) for the example to connect to.

    config ESP_WIFI_PASSWORD
        string "WiFi Password"
        default "mypassword"
        help
            WiFi password (WPA or WPA2) for the example to use.

    config ESP_MAXIMUM_RETRY
        int "Maximum retry"
        default 5
        help
            Set the Maximum retry to avoid station reconnecting to the AP
            unlimited when the AP is really inexistent.

    config WG_PRIVATE_KEY
        string "Wireguard Private Key"
        default "IsvT72MAXzA8EtV0FSD1QT59B4x0oe6Uea5rd/dDzhE="
        help
            Private key of the WireGuard device.

    config WG_LOCAL_IP_ADDRESS
        string "Wireguard local IP address"
        default "192.168.4.58"
        help
            Local IP address of the WireGuard device.

    config WG_LOCAL_IP_NETMASK
        string "Wireguard local netmask"
        default "255.255.255.0"
        help
            Netmask of the local network the WireGuard device belongs to.

    config WG_LOCAL_PORT
        int "Wireguard local port"
        default 11010
        help
            Local port to listen.

    config WG_PEER_PUBLIC_KEY
        string "Wireguard remote peer public key"
        default "FjrsQ/HD1Q8fUlFILIasDlOuajMeZov4NGqMJpkswiw="
        help
            Public key of the remote peer.

    config WG_PRESHARED_KEY
        string "Wireguard pre-shared symmetric key"
        default "0/2H97Sd5EJ9LAAAYUglVjPYv7ihNIm/ziuv6BtSI50="
        help
            Public key of the remote peer.

    config WG_PEER_ADDRESS
        string "Wireguard remote peer address"
        default "demo.wireguard.com"
        help
            Address of the remote peer.

    config WG_PEER_PORT
        int "Wireguard remote peer port"
        default 12912
        help
            Port number of the remote peer.

    config WG_PERSISTENT_KEEP_ALIVE
        int "Interval to send an authenticated empty packet"
        default 0
        help
            A seconds interval, between 1 and 65535 inclusive, of how often to
            send an authenticated empty packet to the peer for the purpose of
            keeping a stateful firewall or NAT mapping valid persistently
    config EXAMPLE_PING_ADDRESS
        string "Target IP address or name"
        default "192.168.4.254"
        help
            Target IP address to send ICMP echo requests.

    config EXAMPLE_RECONNECT_CYCLE
        bool "Disconnect/reconnect the tunnel every 20 seconds"
        default y
        help
            Exercises esp_wireguard_disconnect()/connect() in a loop (Phase 2
            soak). Turn this off for a TCP throughput measurement, since each
            disconnect tears down the interface and any TCP connection on it.

    config EXAMPLE_TEST_CLOCK_WAIT
        bool "Test esp_wireguard_connect()'s wait for the clock to sync"
        default n
        help
            Skips waiting for SNTP before calling esp_wireguard_connect(), and
            starts SNTP only 8 seconds later from a separate task, so the
            library's own "wait until the clock is synced" logic (CHANGES-fork.md
            issue #5) is the thing that has to hold the connection back.

    config EXAMPLE_TEST_CLOCK_NEVER_SYNC
        bool "...and never start SNTP (exercises the wait's timeout path)"
        depends on EXAMPLE_TEST_CLOCK_WAIT
        default n
        help
            With CONFIG_EXAMPLE_TEST_CLOCK_WAIT, never start SNTP at all, so
            esp_wireguard_connect() should give up with ESP_ERR_TIMEOUT after
            CONFIG_WIREGUARD_TIME_SYNC_TIMEOUT_MS instead of connecting.

    menu "TCP throughput test (Phase 4)"
        config EXAMPLE_TCP_TEST_ENABLE
            bool "Enable the TCP throughput test"
            default n
            help
                Runs a simple TCP throughput test over the WireGuard tunnel
                once the peer is up, for CHANGES-fork.md's Phase 4
                (MTU/MSS tuning, throughput testing, 24h soak). This is
                deliberately not iperf or anything protocol-specific: it
                just moves bytes as fast as it can in one direction and
                logs the measured rate, so the far end only needs a plain
                TCP listener or sender, not a particular tool
                (`nc`/netcat is enough on a Linux peer).

        choice EXAMPLE_TCP_TEST_MODE
            prompt "Direction to test"
            depends on EXAMPLE_TCP_TEST_ENABLE
            default EXAMPLE_TCP_TEST_MODE_RX
            help
                RX tests how fast this device can receive over the tunnel
                (it listens; drive it from the peer with e.g.
                `dd if=/dev/zero bs=65536 | nc <this-device-tunnel-ip> <port>`).
                TX tests how fast it can send (it connects out and sends;
                catch it on the peer with e.g.
                `nc -l <port> | pv > /dev/null`, or plain
                `nc -l <port> > /dev/null` without a rate, since the rate
                this tool itself reports is measured at the sending end).
            config EXAMPLE_TCP_TEST_MODE_RX
                bool "Receive (this device listens, peer sends)"
            config EXAMPLE_TCP_TEST_MODE_TX
                bool "Transmit (this device connects out and sends)"
        endchoice

        config EXAMPLE_TCP_TEST_PORT
            int "TCP port"
            depends on EXAMPLE_TCP_TEST_ENABLE
            default 5555

        config EXAMPLE_TCP_TEST_PEER_ADDRESS
            string "Peer's tunnel IP address (TX mode only)"
            depends on EXAMPLE_TCP_TEST_ENABLE
            default "10.252.1.1"
            help
                Where to connect to in TX mode. Not used in RX mode (this
                device is the one listening, so it doesn't need to know
                the peer's address up front -- whichever address actually
                connects is logged when it does). Kept available
                (not hidden) regardless of the chosen direction, purely so
                the option always has a value to build with -- the RX
                build path never reads it.

        config EXAMPLE_TCP_TEST_DURATION_SEC
            int "Test duration (seconds, 0 = run forever)"
            depends on EXAMPLE_TCP_TEST_ENABLE
            default 30
            help
                How long to run before closing the connection and
                reporting a final rate. 0 keeps the connection open
                indefinitely instead (useful for the 24h soak test, run
                alongside the normal connect/disconnect cycling already in
                this demo's app_main()) -- in that case only the periodic
                rate logging applies, not a final summary.
    endmenu
endmenu
```

## examples/tcp_client/main/Kconfig.projbuild
```kconfig
menu "Example Configuration"

    config ESP_WIFI_SSID
        string "WiFi SSID"
        default "myssid"
        help
            SSID (network name) for the example to connect to.

    config ESP_WIFI_PASSWORD
        string "WiFi Password"
        default "mypassword"
        help
            WiFi password (WPA or WPA2) for the example to use.

    config ESP_MAXIMUM_RETRY
        int "Maximum retry"
        default 5
        help
            Set the Maximum retry to avoid station reconnecting to the AP
            unlimited when the AP is really inexistent.

    config WG_PRIVATE_KEY
        string "Wireguard Private Key"
        default "IsvT72MAXzA8EtV0FSD1QT59B4x0oe6Uea5rd/dDzhE="
        help
            Private key of the WireGuard device.

    config WG_LOCAL_IP_ADDRESS
        string "Wireguard local IP address"
        default "192.168.4.58"
        help
            Local IP address of the WireGuard device.

    config WG_LOCAL_IP_NETMASK
        string "Wireguard local netmask"
        default "255.255.255.0"
        help
            Netmask of the local network the WireGuard device belongs to.

    config WG_LOCAL_PORT
        int "Wireguard local port"
        default 11010
        help
            Local port to listen.

    config WG_PEER_PUBLIC_KEY
        string "Wireguard remote peer public key"
        default "FjrsQ/HD1Q8fUlFILIasDlOuajMeZov4NGqMJpkswiw="
        help
            Public key of the remote peer.

    config WG_PRESHARED_KEY
        string "Wireguard pre-shared symmetric key"
        default ""
        help
            Optional pre-shared key of the remote peer. Leave empty to
            disable.

    config WG_PEER_ADDRESS
        string "Wireguard remote peer address"
        default "demo.wireguard.com"
        help
            Address of the remote peer.

    config WG_PEER_PORT
        int "Wireguard remote peer port"
        default 51820
        help
            Port number of the remote peer.

    config WG_PERSISTENT_KEEP_ALIVE
        int "Interval to send an authenticated empty packet"
        default 0
        help
            A seconds interval, between 1 and 65535 inclusive, of how often to
            send an authenticated empty packet to the peer for the purpose of
            keeping a stateful firewall or NAT mapping valid persistently.
            Set to 0 to disable.

    config EXAMPLE_TCP_SERVER_ADDRESS
        string "Peer's tunnel IP address of the TCP service to reach"
        default "10.252.1.1"
        help
            This example is a minimal point-to-point TCP *client*: it
            connects out, over the tunnel, to a plain TCP service already
            running on the peer at this tunnel address -- it does not run a
            server itself. Anything that accepts a TCP connection and
            echoes or responds to what it's sent will do for trying this
            out (e.g. `nc -l <port>` on the peer, or your own service).

    config EXAMPLE_TCP_SERVER_PORT
        int "TCP port of the service to reach"
        default 5555

    config EXAMPLE_TCP_MESSAGE
        string "Message to send on each connection"
        default "hello from esp_wireguard\n"

    config EXAMPLE_TCP_RETRY_INTERVAL_SEC
        int "Seconds between connection attempts"
        default 10
        help
            How long to wait after each attempt (successful or not) before
            connecting again. This example reconnects on a timer rather
            than holding one connection open, to keep it simple -- see
            examples/demo for a long-lived-connection test instead.
endmenu
```
